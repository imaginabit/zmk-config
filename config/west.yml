## config/west.yml
```yaml
manifest:
  defaults:
    revision: v0.3
  remotes:
  - name: zmkfirmware
    url-base: https://github.com/zmkfirmware
    # Additional modules containing boards/shields/custom code can be listed here as well
    # See https://docs.zephyrproject.org/3.2.0/develop/west/manifest.html#projects
  projects:
  - name: zmk
    remote: zmkfirmware
    import: app/west.yml
# Local shield definition - moved to boards/shields/skeletyl/ (FIX: added display-name)
#  - name: zmk-config-handwired-skeletyl
#    url: https://github.com/cyanindya/zmk-config-handwired-skeletyl
#    revision: master
#    path: modules/zmk-config-handwired-skeletyl
```
